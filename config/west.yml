## config/west.yml
```yaml
manifest:
  remotes:
    - name: zmkfirmware
      url-base: https://github.com/zmkfirmware
    - name: ZitaoTech
      url-base: https://github.com/ZitaoTech
    - name: TheCherryTomato
      url-base: https://github.com/TheCherryTomato
  projects:
    - name: zmk
      remote: TheCherryTomato
      revision: bbkeyboard_tp
      import: app/west.yml
  self:
    path: config
```
